## behaviors/Kconfig
```kconfig
menuconfig ZMK_BEHAVIOR_TRACKPAD_TO_POS
    bool "Trackpad to position behavior"
    default y
    help
      Enable the trackpad-to-position behavior that raises position_state_changed
      events for a virtual key position.

menuconfig ZMK_BEHAVIOR_ZIP_DYNAMIC_SCALE
    bool "Dynamic scale adjust behavior"
    default y
    help
      Enable the behavior that adjusts the dynamic scale factor used by
      the dynamic scaler input processor.

menuconfig ZMK_BEHAVIOR_ZIP_DYNAMIC_SCALE_SET
    bool "Dynamic scale set behavior"
    default y
    help
      Enable the behavior that sets the dynamic scale factor used by
      the dynamic scaler input processor.
```
